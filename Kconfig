## Kconfig
```kconfig
mainmenu "NPC Configuration Menu"

config ISA
  string
  default "riscv32"

menu "Devices"

config HAS_SERIAL
  bool "Enable serial (UART)"
  default n

config HAS_TIMER
  bool "Enable timer (RTC)"
  default n

config HAS_VGA
  bool "Enable VGA (SDL 2)"
  default n

config HAS_KEYBOARD
  bool "Enable keyboard"
  default n

endmenu

menu "Memory"

config DPI_MEM
  bool "Use DPI-C memory (backed by NEMU pmem)"
  default n
  help
    When enabled, instruction/data memory are implemented as DPI-C
    slaves that read/write NEMU's physical memory via difftest_memcpy,
    instead of Verilog reg arrays. This removes the 128KB capacity
    limit so large images (e.g. am-tests) can run. Requires DIFFTEST=y.

config DATA_MEM_DELAY
  int "Data memory delay (cycles)"
  default 1
  help
    1 = SRAM speed, 5 = NOR flash, 20 = slow peripheral

endmenu

menu "Testing and Debugging"

config ITRACE
  bool "Enable instruction trace (build/itrace.bin)"
  default n
  help
    When an instruction is consumed, its disassembly is stored in a text file.

config CACHESIM
  bool "Run cachesim after make run"
  depends on ITRACE
  default n
  help
    



config HAS_LFSR
  bool "Enable LFSR random delay (bus stress test)"
  default n

config WAVE
  bool "Enable VCD waveform output"
  default n

config BATCH
  bool "Enable batch mode (auto -b, run to completion)"
  default n
  help
    When enabled, 'make run' passes -b to the simulator so it runs
    the program to completion without entering the SDB prompt.

config DIFFTEST
  bool "Enable differential testing (vs NEMU ref.so)"
  default n
  help
    When enabled, NPC runs alongside NEMU (riscv32-nemu-interpreter-so)
    and compares PC + GPR after every committed instruction.
    Requires: nemu/build/riscv32-nemu-interpreter-so.
config PERF
  bool "Enable performance counters (perf.v)"
  default n
  help
    use perf.v to display cpi and other info


endmenu


menu "Printing"


config PRINT_ICACHE
  bool "Print [icache] hit rate after halt"
  default y
  help
    print icache hit rate

endmenu

menu "Cache Configuration"

config ICACHE_INDEX_BITS
    int "ICACHE index bits (blocks = 2^N, #BLOCK_BYTES each)"
    range 2 10
    default 4
    help
      Number of ICACHE blocks = 2^N
        4 ->   16 blocks
        5 ->   32 blocks
        6 ->   64 blocks
        7 ->  128 blocks

config ICACHE_BLOCK_BYTES
  int "ICACHE block size (bytes)"
  range 4 64
  default 4
  help
    eg: 4 means a cache block contains 4 Bytes(32 bits),bigger size needs to be refilled first


endmenu
```

## soc/Kconfig
```kconfig
mainmenu "ysyxSoC simulation configuration menu"

menu "Testing and Debuging"

config DIFFTEST
    bool "Enable differencial testing"
    default n
    help
        Use Nemu as reference for differencial testing

endmenu
```
